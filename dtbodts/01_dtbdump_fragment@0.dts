/dts-v1/;

/ {

	__fixups__ {
		firmware = "/fragment@0:target:0";
		gpio_wifi_ctl = "/fragment@1:target:0";
	};

	fragment@0 {
		target = <0xffffffff>;

		__overlay__ {

			android {

				vbmeta {
					by_name_prefix = "/dev/block/platform/mstar_mci.0/by-name/vbmeta";
					compatible = "android,vbmeta";
					parts = "vbmeta,boot,system,vendor,linux_rootfs_a,3rd_a,tvservice,factory_a";
				};
			};
		};
	};

	fragment@1 {
		target = <0xffffffff>;

		__overlay__ {
			wifi-ctl-delayms = <0xc8>;
			wifi-ctl-gpio = <0x1c>;
			wifi-ctl-invert = <0x1>;
			wifi-ctl-powerdown = <0x0>;
		};
	};
};
